## Config.in
```kconfig
menu "GameJay packages"
	source "$BR2_EXTERNAL_GAMEJAY_PATH/package/gamejay-menu/Config.in"
	source "$BR2_EXTERNAL_GAMEJAY_PATH/package/retroarch/Config.in"
	source "$BR2_EXTERNAL_GAMEJAY_PATH/package/libretro-snes9x2010/Config.in"
	source "$BR2_EXTERNAL_GAMEJAY_PATH/package/libretro-fceumm/Config.in"
	source "$BR2_EXTERNAL_GAMEJAY_PATH/package/libretro-picodrive/Config.in"
	source "$BR2_EXTERNAL_GAMEJAY_PATH/package/libretro-mame2003-plus/Config.in"
	source "$BR2_EXTERNAL_GAMEJAY_PATH/package/libretro-pcsx-rearmed/Config.in"
endmenu
```

## configs/gamejay_base_x86_64_defconfig
```kconfig
BR2_x86_64=y
BR2_x86_64_GENERIC=y
BR2_TOOLCHAIN_EXTERNAL=y
BR2_TOOLCHAIN_EXTERNAL_BOOTLIN=y
BR2_TOOLCHAIN_EXTERNAL_BOOTLIN_X86_64_GLIBC_STABLE=y
BR2_TOOLCHAIN_BUILDROOT_CXX=y
BR2_CCACHE=y
BR2_ENABLE_LOCALE=y
BR2_ROOTFS_DEVICE_CREATION_DYNAMIC_EUDEV=y

BR2_PACKAGE_BUSYBOX_SHOW_OTHERS=y
BR2_PACKAGE_ALSA_UTILS=y
BR2_PACKAGE_ALSA_UTILS_APLAY=y
BR2_PACKAGE_ALSA_UTILS_AMIXER=y
BR2_PACKAGE_LIBEVDEV=y
BR2_PACKAGE_LIBDRM=y
BR2_PACKAGE_LIBDRM_INTEL=y
BR2_PACKAGE_LIBDRM_AMDGPU=y
BR2_PACKAGE_LIBDRM_RADEON=y
BR2_PACKAGE_LINUX_FIRMWARE=y
BR2_PACKAGE_LINUX_FIRMWARE_AMDGPU=y
BR2_PACKAGE_LINUX_FIRMWARE_RADEON=y

BR2_PACKAGE_MESA3D=y
BR2_PACKAGE_MESA3D_GALLIUM_DRIVER_CROCUS=y
BR2_PACKAGE_MESA3D_GALLIUM_DRIVER_IRIS=y
BR2_PACKAGE_MESA3D_GALLIUM_DRIVER_R300=y
BR2_PACKAGE_MESA3D_GALLIUM_DRIVER_R600=y
BR2_PACKAGE_MESA3D_GALLIUM_DRIVER_SWRAST=y
BR2_PACKAGE_MESA3D_OPENGL_EGL=y
BR2_PACKAGE_MESA3D_OPENGL_ES=y

BR2_PACKAGE_SDL2=y
BR2_PACKAGE_SDL2_KMSDRM=y
BR2_PACKAGE_SDL2_OPENGLES=y
BR2_PACKAGE_SDL2_TTF=y
BR2_PACKAGE_DEJAVU=y
BR2_PACKAGE_EXFATPROGS=y
BR2_PACKAGE_UTIL_LINUX=y
BR2_PACKAGE_UTIL_LINUX_LIBBLKID=y
BR2_PACKAGE_UTIL_LINUX_BINARIES=y

BR2_TARGET_ROOTFS_TAR=n

BR2_TARGET_GRUB2=y
BR2_TARGET_GRUB2_I386_PC=y
BR2_TARGET_GRUB2_X86_64_EFI=y
BR2_TARGET_GRUB2_INSTALL_TOOLS=y
BR2_TARGET_GRUB2_BOOT_PARTITION="hd0,msdos1"
BR2_TARGET_GRUB2_BUILTIN_MODULES_PC="boot linux ext2 fat part_msdos normal biosdisk search search_label"
BR2_TARGET_GRUB2_BUILTIN_MODULES_EFI="boot linux ext2 fat part_gpt normal efi_gop search search_label"
```

## configs/gamejay_cores_x86_64_defconfig
```kconfig
BR2_x86_64=y
BR2_x86_64_GENERIC=y
BR2_TOOLCHAIN_EXTERNAL=y
BR2_TOOLCHAIN_EXTERNAL_BOOTLIN=y
BR2_TOOLCHAIN_EXTERNAL_BOOTLIN_X86_64_GLIBC_STABLE=y
BR2_TOOLCHAIN_BUILDROOT_CXX=y
BR2_CCACHE=y

BR2_PACKAGE_LIBRETRO_SNES9X2010=y
BR2_PACKAGE_LIBRETRO_FCEUMM=y
BR2_PACKAGE_LIBRETRO_PICODRIVE=y
BR2_PACKAGE_LIBRETRO_MAME2003_PLUS=y
BR2_PACKAGE_LIBRETRO_PCSX_REARMED=y
```

## configs/gamejay_kernel_x86_64_defconfig
```kconfig
BR2_x86_64=y
BR2_x86_64_GENERIC=y
BR2_TOOLCHAIN_EXTERNAL=y
BR2_TOOLCHAIN_EXTERNAL_BOOTLIN=y
BR2_TOOLCHAIN_EXTERNAL_BOOTLIN_X86_64_GLIBC_STABLE=y
BR2_CCACHE=y

BR2_LINUX_KERNEL=y
BR2_LINUX_KERNEL_CUSTOM_VERSION=y
BR2_LINUX_KERNEL_CUSTOM_VERSION_VALUE="6.12.17"
BR2_LINUX_KERNEL_USE_DEFCONFIG=y
BR2_LINUX_KERNEL_DEFCONFIG="x86_64"
BR2_LINUX_KERNEL_CONFIG_FRAGMENT_FILES="$(BR2_EXTERNAL_GAMEJAY_PATH)/board/gamejay/linux-fragment.config"
BR2_LINUX_KERNEL_NEEDS_HOST_OPENSSL=y
BR2_LINUX_KERNEL_NEEDS_HOST_LIBELF=y
```

## configs/gamejay_x86_64_defconfig
```kconfig
BR2_x86_64=y
BR2_x86_64_GENERIC=y
BR2_TOOLCHAIN_EXTERNAL=y
BR2_TOOLCHAIN_EXTERNAL_BOOTLIN=y
BR2_TOOLCHAIN_EXTERNAL_BOOTLIN_X86_64_GLIBC_STABLE=y
BR2_TOOLCHAIN_BUILDROOT_CXX=y
BR2_CCACHE=y
BR2_ENABLE_LOCALE=y
BR2_ROOTFS_DEVICE_CREATION_DYNAMIC_DEVTMPFS=y
BR2_TARGET_GENERIC_HOSTNAME="gamejay"
BR2_TARGET_GENERIC_ISSUE="GameJay OS"
BR2_TARGET_GENERIC_GETTY=n
BR2_TARGET_GENERIC_REMOUNT_ROOTFS_RW=n
BR2_ROOTFS_OVERLAY="$(BR2_EXTERNAL_GAMEJAY_PATH)/rootfs-overlay"
BR2_ROOTFS_POST_BUILD_SCRIPT="$(BR2_EXTERNAL_GAMEJAY_PATH)/board/gamejay/post-build.sh"
BR2_ROOTFS_POST_IMAGE_SCRIPT="$(BR2_EXTERNAL_GAMEJAY_PATH)/board/gamejay/post-image.sh"

BR2_PACKAGE_GAMEJAY_PREBUILT_BASE=y
BR2_PACKAGE_GAMEJAY_MENU=y
BR2_PACKAGE_GAMEJAY_PREBUILT_CORES=y
BR2_PACKAGE_RETROARCH=y

BR2_TARGET_ROOTFS_EXT2=y
BR2_TARGET_ROOTFS_EXT2_4=y
BR2_TARGET_ROOTFS_EXT2_SIZE="768M"
BR2_TARGET_ROOTFS_EXT2_LABEL="GAMEJAY"
BR2_TARGET_ROOTFS_EXT2_MKFS_OPTIONS="-O ^metadata_csum_seed"
BR2_TARGET_ROOTFS_TAR=n

BR2_PACKAGE_HOST_DOSFSTOOLS=y
BR2_PACKAGE_HOST_EXFATPROGS=y
BR2_PACKAGE_HOST_GENIMAGE=y
BR2_PACKAGE_HOST_MTOOLS=y
```

## package/gamejay-menu/Config.in
```kconfig
config BR2_PACKAGE_GAMEJAY_MENU
	bool "gamejay-menu"
	depends on BR2_PACKAGE_GAMEJAY_PREBUILT_BASE
	help
	  Controller-first SDL2 launcher for GameJay OS.
```

## package/gamejay-prebuilt-base/Config.in
```kconfig
config BR2_PACKAGE_GAMEJAY_PREBUILT_BASE
	bool "GameJay prebuilt ABI-matched base"
	help
	  Install the checksum-verified target, staging, and bootloader
	  bundle prepared by the Build GameJay images workflow.
```

## package/gamejay-prebuilt-cores/Config.in
```kconfig
config BR2_PACKAGE_GAMEJAY_PREBUILT_CORES
	bool "GameJay prebuilt libretro cores"
	help
	  Install the checksum-verified core bundle prepared by the
	  Build-gamejay-img workflow.
```

## package/libretro-fceumm/Config.in
```kconfig
config BR2_PACKAGE_LIBRETRO_FCEUMM
	bool "fceumm core"
	help
	  FCEUmm Nintendo Entertainment System libretro core.
```

## package/libretro-mame2003-plus/Config.in
```kconfig
config BR2_PACKAGE_LIBRETRO_MAME2003_PLUS
	bool "mame2003-plus core"
	help
	  MAME 2003-Plus arcade libretro core.
```

## package/libretro-pcsx-rearmed/Config.in
```kconfig
config BR2_PACKAGE_LIBRETRO_PCSX_REARMED
	bool "pcsx-rearmed core"
	depends on BR2_INSTALL_LIBSTDCPP
	help
	  PCSX-ReARMed PlayStation libretro core. On x86_64 this uses its
	  portable/lightrec implementation rather than ARM NEON assembly.
```

## package/libretro-picodrive/Config.in
```kconfig
config BR2_PACKAGE_LIBRETRO_PICODRIVE
	bool "picodrive core"
	help
	  PicoDrive Sega Genesis, Mega Drive, Sega CD, and 32X core.
```

## package/libretro-snes9x2010/Config.in
```kconfig
config BR2_PACKAGE_LIBRETRO_SNES9X2010
	bool "snes9x2010 core"
	help
	  Performance-focused Super Nintendo libretro core.
```

## package/retroarch/Config.in
```kconfig
config BR2_PACKAGE_RETROARCH
	bool "retroarch"
	depends on BR2_PACKAGE_GAMEJAY_PREBUILT_BASE
	depends on BR2_TOOLCHAIN_HAS_THREADS
	help
	  RetroArch libretro frontend configured for DRM/KMS, SDL2, ALSA,
	  and udev.
```
